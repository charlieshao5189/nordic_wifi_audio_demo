## CMakeLists.txt
```
#
# Copyright (c) 2022 Nordic Semiconductor ASA
#
# SPDX-License-Identifier: LicenseRef-Nordic-5-Clause
#

cmake_minimum_required(VERSION 3.20.0)

# Flag which defines whether application is compiled as gateway/dongle or headset
add_compile_definitions(HEADSET=1)
add_compile_definitions(GATEWAY=2)

find_package(Zephyr REQUIRED HINTS $ENV{ZEPHYR_BASE})

project(wifi_audio_transceiver)

string(TIMESTAMP NRF5340_AUDIO_CORE_APP_COMP_DATE "%a %b %d %H:%M:%S %Y")
message(NRF5340_WIFI_AUDIO_COMP_DATE="${NRF5340_AUDIO_CORE_APP_COMP_DATE}")

# Generate fw_info_app.c
configure_file("${CMAKE_CURRENT_SOURCE_DIR}/src/utils/fw_info_app.c.in"
               "${CMAKE_BINARY_DIR}/fw_info_app.c"
               @ONLY)

# Target sources below are specific to the nRF5340 Audio DK HW
target_sources(app PRIVATE
    ${CMAKE_BINARY_DIR}/fw_info_app.c
    )
if (CONFIG_AUDIO_HEADSET)
	add_subdirectory(wifi_audio_headset)
endif()

if (CONFIG_AUDIO_GATEWAY)
	add_subdirectory(wifi_audio_gateway)
endif()
# target_include_directories(app PUBLIC
zephyr_library_include_directories(
        include
        src
        src/audio
        src/net
        src/drivers
        src/modules
        src/utils
        src/utils/macros
        # ${ZEPHYR_NRF_MODULE_DIR}/boards/arm/nrf5340_audio_dk_nrf5340
        )

zephyr_library_include_directories(app PRIVATE
${ZEPHYR_NRF_MODULE_DIR}/boards/arm/nrf5340_audio_dk_nrf5340)

add_subdirectory(src/audio)
add_subdirectory(src/net)
add_subdirectory(src/drivers)
add_subdirectory(src/modules)
add_subdirectory(src/utils)

## Cirrus Logic
if (CONFIG_HW_CODEC_CIRRUS_LOGIC)
    if (ZEPHYR_CIRRUS_LOGIC_MODULE_DIR)
        add_subdirectory(${ZEPHYR_CIRRUS_LOGIC_MODULE_DIR} cirrus_logic_bin_dir)
    else()
        message(FATAL_ERROR "Cirrus Logic/sdk-mcu-drivers repository not found\n")
    endif()
endif()

# build counter
# Set a cached variable for the build count (default is 0)
if(NOT DEFINED WIFI_AUDIO_CMAKE_BUILD_COUNT)
    set(WIFI_AUDIO_CMAKE_BUILD_COUNT 0 CACHE STRING "Number of times the project has been built")
endif()
# Increment the build count
math(EXPR WIFI_AUDIO_CMAKE_BUILD_COUNT "${WIFI_AUDIO_CMAKE_BUILD_COUNT} + 1")
# Update the cached value
set(WIFI_AUDIO_CMAKE_BUILD_COUNT ${WIFI_AUDIO_CMAKE_BUILD_COUNT} CACHE STRING "Number of times the project has been built" FORCE)
# Print the current build count to the console
message(STATUS "Build count: ${WIFI_AUDIO_CMAKE_BUILD_COUNT}")
```

## Kconfig
```
#
# Copyright (c) 2024 Nordic Semiconductor
#
# SPDX-License-Identifier: LicenseRef-Nordic-5-Clause
#

#----------------------------------------------------------------------------#
rsource "Kconfig.defaults"

menu "WiFi Audio Transceiver"
          
choice AUDIO_DEV_ROLE
	prompt "Choose device role from transmite, receiver and walkie talkie"
	default AUDIO_GATEWAY

config AUDIO_GATEWAY
	bool "Play audio stream transmiter role"

config AUDIO_HEADSET
	bool "Play audio stream receiver role"

endchoice #AUDIO_DEV_ROLE

config AUDIO_WALKIE_TALKIE
	bool "Enable walkie talkie feature, can enabled on both gateway and headset"
        default n

endmenu # "Audio Stream Transceiver"

if (AUDIO_GATEWAY = y)
rsource "wifi_audio_gateway/Kconfig.defaults"
endif

if (AUDIO_HEADSET = y)
rsource "wifi_audio_headset/Kconfig.defaults"
endif 

rsource "src/audio/Kconfig"
rsource "src/net/Kconfig"
rsource "src/drivers/Kconfig"
rsource "src/modules/Kconfig"
rsource "src/utils/Kconfig"

#----------------------------------------------------------------------------#
menu "Logging"

module = MAIN
module-str = main
source "subsys/logging/Kconfig.template.log_config"

config PRINT_STACK_USAGE_MS
	depends on THREAD_ANALYZER && INIT_STACKS
	int "Print stack usage every x milliseconds"
	default 5000

endmenu # Log levels

source "Kconfig.zephyr"


#----------------------------------------------------------------------------#

menu "SoftAP Wi-Fi provision sample"

config SOFTAP_WIFI_PROVISION_SAMPLE_PSM_DISABLED_SECONDS
	int "Wi-Fi PSM disabled seconds"
	default 120
	help
	  Time in seconds that Wi-Fi power saving mode is disabled after completed provisioning.
	  Disabling Power Save Mode is needed to make the device discoverable reliably via
	  mDNS post provisioning.
	  Service Discovery has proven to be unstable in PSM.

module = SOFTAP_WIFI_PROVISION_SAMPLE
module-str = SoftAP Wi-Fi provision sample

endmenu
```

## Kconfig.defaults
```
#
# Copyright (c) 2022 Nordic Semiconductor ASA
#
# SPDX-License-Identifier: LicenseRef-Nordic-5-Clause
#

config REBOOT
	default y

config MAIN_THREAD_PRIORITY
	default 10

config MAIN_STACK_SIZE
	default 1800 if SD_CARD_PLAYBACK
	default 1600

config SYSTEM_WORKQUEUE_STACK_SIZE
	default 1200

# As long as thread names are used, config must be set to "y"
config THREAD_NAME
	default y

config NCS_INCLUDE_RPMSG_CHILD_IMAGE
	default n

# Workaround to not use fatal_error.c in NCS. Note that the system may still
# reset on error depending on the build configuraion
config RESET_ON_FATAL_ERROR
	default n

# # Default Config for Debug and Release build
# config BT
# 	default y

# config BOARD_ENABLE_DCDC_APP
# 	default y

# config BOARD_ENABLE_DCDC_NET
# 	default y

# config BOARD_ENABLE_CPUNET
# 	default y

config ZBUS
	default y

config ZBUS_RUNTIME_OBSERVERS
	default y

config ZBUS_MSG_SUBSCRIBER
	default y

config SENSOR
	default y

config REGULATOR
	default y

config CONTIN_ARRAY
	default y

config NRFX_I2S0
	default y

config PCM_MIX
	default y

config PSCM
	default y

config DATA_FIFO
	default y

# Enable NRFX_CLOCK for ACLK control
config NRFX_CLOCK
	default y

config I2C
	default y

choice LIBC_IMPLEMENTATION
	# NOTE: Since we are not using minimal libc, error codes from
	#       minimal libc are not used
	default NEWLIB_LIBC
endchoice

# Audio codec LC3 related defines
# FPU_SHARING enables preservation of the hardware floating point registers
# across context switches to allow multiple threads to perform concurrent
# floating point operations.
config FPU
	default y

config FPU_SHARING
	default y

# Enable SDHC interface
config DISK_DRIVERS
	default y

config DISK_DRIVER_SDMMC
	default y

# Enable SPI interface
config SPI
	default y

# Enable ADC for board version readback
config ADC
	default y

# Allocate buffer on RAM for transferring chunck of data
# from Flash to SPI
config SPI_NRFX_RAM_BUFFER_SIZE
	default 8

# Config the file system
config FILE_SYSTEM
	default y

config FAT_FILESYSTEM_ELM
	default y

config FS_FATFS_LFN
	default y
choice FS_FATFS_LFN_MODE
	# Using stack for LFN work queue
	default FS_FATFS_LFN_MODE_STACK
endchoice

# exFAT enabled to support longer file names and higher transfer speed
config FS_FATFS_EXFAT
	default y

# Set the maximum file name length to 255
config FS_FATFS_MAX_LFN
	default 255

config WATCHDOG
	default y

config TASK_WDT
	default y
```

## prj.conf
```kconfig
#
# Copyright (c) 2022 Nordic Semiconductor ASA
#
# SPDX-License-Identifier: LicenseRef-Nordic-5-Clause
#

# Build as Audio Gateway by default
CONFIG_AUDIO_GATEWAY=y
CONFIG_SOCKET_ROLE_SERVER=y

# Logging
CONFIG_LOG=y
CONFIG_LOG_BUFFER_SIZE=2400
CONFIG_LOG_DEFAULT_LEVEL=3
CONFIG_STREAMCTRL_LOG_LEVEL_DBG=y

# DK library
CONFIG_DK_LIBRARY=y

# Memories
CONFIG_INIT_STACKS=y
CONFIG_MAIN_STACK_SIZE=4096
CONFIG_HEAP_MEM_POOL_SIZE=213024
CONFIG_SYSTEM_WORKQUEUE_STACK_SIZE=2048
CONFIG_ENCODER_STACK_SIZE=24000
CONFIG_NET_CONNECTION_MANAGER_MONITOR_STACK_SIZE=4850
CONFIG_BUTTON_PUBLISH_STACK_SIZE= 512
CONFIG_SOCKET_STACK_SIZE=5000
CONFIG_SHELL_STACK_SIZE=8192

# Kernel options
CONFIG_ENTROPY_GENERATOR=y

# ZBUS options
CONFIG_ZBUS=y
CONFIG_ZBUS_LOG_LEVEL_INF=y
CONFIG_ZBUS_CHANNEL_NAME=y
CONFIG_ZBUS_OBSERVER_NAME=y
CONFIG_ZBUS_MSG_SUBSCRIBER=y
CONFIG_ZBUS_MSG_SUBSCRIBER_NET_BUF_POOL_SIZE=32

# Debug options
CONFIG_DEBUG=y
# CONFIG_SW_CODEC_SELECT_LOG_LEVEL_DBG=y
# CONFIG_SOCKET_UTIL_MODULE_LOG_LEVEL_DBG=y
# CONFIG_WIFI_AUDIO_RX_LOG_LEVEL_DBG=y
CONFIG_AUDIO_SYSTEM_LOG_LEVEL_DBG=y
CONFIG_AUDIO_DATAPATH_LOG_LEVEL_DBG=y
# CONFIG_MODULE_AUDIO_USB_LOG_LEVEL_DBG=y

CONFIG_THREAD_ANALYZER=n
CONFIG_THREAD_ANALYZER_USE_PRINTK=y
CONFIG_THREAD_ANALYZER_AUTO=y
CONFIG_THREAD_ANALYZER_AUTO_INTERVAL=5

CONFIG_SYS_HEAP_LISTENER=n
CONFIG_SYS_HEAP_RUNTIME_STATS=y

# Disable double promotion warnings in opus library

CONFIG_COMPILER_OPT="-Wno-double-promotion -Wno-maybe-uninitialized -Wno-unused-variable" 
```

## overlay-audio-gateway.conf
```kconfig
CONFIG_NET_HOSTNAME="AudioGateway"

CONFIG_MDNS_RESPONDER=y
# CONFIG_MDNS_RESPONDER_LOG_LEVEL_DBG=y
CONFIG_DNS_SD=y
CONFIG_MDNS_RESPONDER_DNS_SD=y
CONFIG_NET_HOSTNAME_ENABLE=y
```

## overlay-audio-headset.conf
```kconfig
CONFIG_AUDIO_HEADSET=y
CONFIG_SOCKET_ROLE_CLIENT=y


CONFIG_NET_HOSTNAME="AudioHeadset"

CONFIG_MDNS_QUERY_NAME="AudioGateway"
CONFIG_MDNS_QUERY_ATTEMPTS=5

# Enable the DNS resolver
CONFIG_DNS_RESOLVER=y
# CONFIG_DNS_RESOLVER_LOG_LEVEL_DBG=y
# Enable additional buffers
CONFIG_DNS_RESOLVER_ADDITIONAL_BUF_CTR=5
# Enable additional queries
CONFIG_DNS_RESOLVER_ADDITIONAL_QUERIES=2
# Enable mDNS support
CONFIG_MDNS_RESOLVER=y

CONFIG_DNS_RESOLVER_MAX_SERVERS=2
CONFIG_DNS_SERVER_IP_ADDRESSES=y
CONFIG_DNS_NUM_CONCUR_QUERIES=5

# DNS resolver cache does not work with the current implementation
#     current debugging gives that the received ttl is 0
# CONFIG_DNS_RESOLVER_CACHE=y

# Set the DNS timeout to 1 second as this is the minimum time, because the dns request are only mDNS and should be fast
CONFIG_NET_SOCKETS_DNS_TIMEOUT=1000
```

## overlay-opus.conf
```kconfig
CONFIG_SW_CODEC_OPUS=y
```

## overlay-softap.conf
```kconfig
# Disable WiFi Station Mode first



# Enable Soft AP Mode
CONFIG_NRF700X_AP_MODE=y
CONFIG_WPA_SUPP_AP=y
CONFIG_WPA_SUPP_LOG_LEVEL_INF=y
CONFIG_WIFI_READY_LIB=y
CONFIG_FILE_SYSTEM=y

CONFIG_SOFTAP_5GHz=y
CONFIG_SOFTAP_CHANNEL=36
CONFIG_SOFTAP_REG_DOMAIN="NO"
CONFIG_SOFTAP_SSID="WiFi_Audio_AP"
CONFIG_SOFTAP_PASSWORD="Auido@WiFi"
```

## overlay-sta-static.conf
```kconfig
CONFIG_WIFI_CREDENTIALS_STATIC=y
CONFIG_WIFI_CREDENTIALS_STATIC_SSID="myssid"
CONFIG_WIFI_CREDENTIALS_STATIC_PASSWORD="mypassword"
```

## overlay-tcp.conf
```kconfig
CONFIG_SOCKET_TYPE_TCP=y
```

## boards/nrf5340_audio_dk_nrf5340_cpuapp.overlay
```dts
/*
 * Copyright (c) 2024 Nordic Semiconductor ASA
 *
 * SPDX-License-Identifier: LicenseRef-Nordic-5-Clause
 */

/{
        gpio_fwd: nrf-gpio-forwarder {
                compatible = "nordic,nrf-gpio-forwarder";
                status = "disabled";
               };
};
```

## src/main.c
```c
/*
 * Copyright (c) 2022 Nordic Semiconductor ASA
 *
 * SPDX-License-Identifier: LicenseRef-Nordic-5-Clause
 */

/** @file
 * @brief WiFi Transceiver
 */

#define MODULE main

//#include <zephyr/logging/log.h>
//LOG_MODULE_REGISTER(MODULE, CONFIG_MAIN_LOG_LEVEL);
#include "streamctrl.h"
#include "audio/opus/audio_codec_opus_api.h"

static enum stream_state strm_state = STATE_PAUSED;

uint8_t stream_state_get(void)
{
	return strm_state;
}

void streamctrl_send(void const *const data, size_t size, uint8_t num_ch)
{
	ARG_UNUSED(data);
	ARG_UNUSED(size);
	ARG_UNUSED(num_ch);

	//LOG_WRN("Sending is not possible for broadcast sink");
}

int main(void)
{
    //LOG_INF("WiFi Audio Transceiver Start!");
    audio_codec_opus_init();
}
```

## src/socket_util.h
```c
#ifndef __SOCKET_UTIL_H
#define __SOCKET_UTIL_H

#include <zephyr/kernel.h>

#define CAM_COMMAND_MAX_SIZE 6

enum wifi_modes {
        WIFI_STATION_MODE = 0,
        WIFI_SOFTAP_MODE,
};

typedef void (*net_util_socket_rx_callback_t)(uint8_t *data, uint16_t len);

void net_util_set_callback(net_util_socket_rx_callback_t socket_rx_callback);
void socket_tx(const void *buf, size_t len);

uint8_t process_socket_rx(char *udp_rx_buf, char *command_buf);

#endif
```

## src/wifi_station_mode.c
```c
/*
 * Copyright (c) 2024 Nordic Semiconductor ASA
 *
 * SPDX-License-Identifier: LicenseRef-Nordic-5-Clause
 */
#include <zephyr/logging/log.h>
LOG_MODULE_REGISTER(wifi_station_mode, CONFIG_LOG_DEFAULT_LEVEL);

#include <errno.h>
#include <stddef.h>
#include <string.h>
#include <stdio.h>
#include <zephyr/kernel.h>
#include <zephyr/types.h>
/* Macro called upon a fatal error, reboots the device. */
#include <zephyr/sys/reboot.h>

/* Include the necessary header files */
#include <zephyr/net/net_if.h>
#include <zephyr/net/wifi.h>
#include <zephyr/net/wifi_mgmt.h>
#include <zephyr/net/net_mgmt.h>
#include <zephyr/net/net_event.h>
#include <zephyr/net/socket.h>
#include <net/wifi_mgmt_ext.h>
/* For net_sprint_ll_addr_buf */
#include "net_private.h"


/* Include the header file for the Wi-FI credentials library */
#include <net/wifi_credentials.h>

#include <dk_buttons_and_leds.h>
#include <zephyr/logging/log_ctrl.h>

/* Define a macro for the relevant network events */
#define L2_EVENT_MASK (NET_EVENT_WIFI_CONNECT_RESULT | NET_EVENT_WIFI_DISCONNECT_RESULT)
#define L3_EVENT_MASK NET_EVENT_IPV4_DHCP_BOUND

/**********External Resources START**************/
extern struct k_sem wifi_net_ready;
/**********External Resources END**************/

/* Declare the callback structure for Wi-Fi events */
static struct net_mgmt_event_callback wifi_mgmt_cb;
static struct net_mgmt_event_callback net_mgmt_cb;

/* Define the boolean wifi_connected and the semaphore wifi_net_ready */
static bool wifi_connected;

static int cmd_wifi_status(void)
{
	struct net_if *iface;
	struct wifi_iface_status status = { 0 };

	iface = net_if_get_first_wifi();
	if (!iface) {
		LOG_ERR("Failed to get Wi-FI interface");
		return -ENOEXEC;
	}

	if (net_mgmt(NET_REQUEST_WIFI_IFACE_STATUS, iface, &status,
				sizeof(struct wifi_iface_status))) {
		LOG_ERR("Status request failed");
		return -ENOEXEC;
	}

	LOG_INF("Status: successful");
	LOG_INF("==================");
	LOG_INF("State: %s", wifi_state_txt(status.state));

	if (status.state >= WIFI_STATE_ASSOCIATED) {
		uint8_t mac_string_buf[sizeof("xx:xx:xx:xx:xx:xx")];

		LOG_INF("Interface Mode: %s", wifi_mode_txt(status.iface_mode));
		LOG_INF("Link Mode: %s", wifi_link_mode_txt(status.link_mode));
		LOG_INF("SSID: %.32s", status.ssid);
		LOG_INF("BSSID: %s",
			net_sprint_ll_addr_buf(status.bssid,
					       WIFI_MAC_ADDR_LEN, mac_string_buf,
					       sizeof(mac_string_buf)));
		LOG_INF("Band: %s", wifi_band_txt(status.band));
		LOG_INF("Channel: %d", status.channel);
		LOG_INF("Security: %s", wifi_security_txt(status.security));
		LOG_INF("MFP: %s", wifi_mfp_txt(status.mfp));
		LOG_INF("Beacon Interval: %d", status.beacon_interval);
		LOG_INF("DTIM: %d", status.dtim_period);
		LOG_INF("TWT: %s",
			status.twt_capable ? "Supported" : "Not supported");
	}

	return 0;
}


static void wifi_mgmt_event_handler(struct net_mgmt_event_callback *cb,
									uint32_t mgmt_event, struct net_if *iface)
{
	switch (mgmt_event)
	{
	case NET_EVENT_WIFI_CONNECT_RESULT:
		LOG_INF("WiFi connected");
		wifi_connected = true;
		break;
	case NET_EVENT_WIFI_DISCONNECT_RESULT:
		if (wifi_connected == false)
		{
			LOG_INF("Waiting for WiFi to be wifi_connected");
		}
		else
		{
			dk_set_led_off(DK_LED1);
			LOG_INF("WiFi disconnected");
			wifi_connected = false;
		}
		k_sem_reset(&wifi_net_ready);
		break;
	default:
		break;
	}
	cmd_wifi_status();
}

static void on_net_event_dhcp_bound(struct net_mgmt_event_callback *cb)
{
	/* Get DHCP info from struct net_if_dhcpv4 and print */
	const struct net_if_dhcpv4 *dhcpv4 = cb->info;
	const struct in_addr *addr = &dhcpv4->requested_ip;
	char dhcp_info[128];
	net_addr_ntop(AF_INET, addr, dhcp_info, sizeof(dhcp_info));
	LOG_INF("\r\n\r\nWiFi is ready on nRF5340 Audio DK + nRF7002EK. Try to connect the socket(udp by default) to address %s:60010.\r\n", dhcp_info);
}

/* Define the callback function for network events */
static void net_mgmt_event_handler(struct net_mgmt_event_callback *cb,
								   uint32_t mgmt_event, struct net_if *iface)
{
	if ((mgmt_event & L3_EVENT_MASK) != mgmt_event)
	{
		return;
	}

	if (mgmt_event == NET_EVENT_IPV4_DHCP_BOUND)
	{
		LOG_INF("Network DHCP bound");
		on_net_event_dhcp_bound(cb);
		dk_set_led_on(DK_LED1);
		k_sem_give(&wifi_net_ready);
		return;
	}
}

int wifi_station_mode_ready(void)
{

        /* Wait to allow initialization of Wi-Fi driver */
	k_sleep(K_SECONDS(1));

        /* Initialize and add the callback function for network events */
	net_mgmt_init_event_callback(&wifi_mgmt_cb, wifi_mgmt_event_handler, L2_EVENT_MASK);
	net_mgmt_add_event_callback(&wifi_mgmt_cb);

	net_mgmt_init_event_callback(&net_mgmt_cb, net_mgmt_event_handler, L3_EVENT_MASK);
	net_mgmt_add_event_callback(&net_mgmt_cb);

#if defined(CONFIG_WIFI_CREDENTIALS_STATIC)
	/* Declare the variable for the network configuration parameters */

	/* Get the network interface */
	struct net_if *iface = net_if_get_first_wifi();
	if (iface == NULL)
	{
		LOG_ERR("Returned network interface is NULL");
		return -1;
	}

	/* Call net_mgmt() to request the Wi-Fi connection */
	LOG_INF("Connecting to Wi-Fi with static crendentials.");
	int err = net_mgmt(NET_REQUEST_WIFI_CONNECT_STORED, iface, NULL, 0);
        if (err)
	{
		LOG_ERR("Connecting to Wi-Fi failed, err: %d", err);
		return ENOEXEC;
	}
#else
	LOG_INF("\r\n\r\nRunnning on WiFi Station mode.\r\nPlease connect to router with 'wifi_cred' commands, use 'wifi_cred help' to get help.\r\n");
#endif
        k_sem_take(&wifi_net_ready, K_FOREVER);
	return 0;
}
```

## src/zbus_common.h
```c
/*
 * Copyright (c) 2023 Nordic Semiconductor ASA
 *
 * SPDX-License-Identifier: LicenseRef-Nordic-5-Clause
 */

#ifndef _ZBUS_COMMON_H_
#define _ZBUS_COMMON_H_

#include <zephyr/bluetooth/audio/audio.h>

#define ZBUS_READ_TIMEOUT_MS    K_MSEC(100)
#define ZBUS_ADD_OBS_TIMEOUT_MS K_MSEC(200)

/***** Messages for zbus ******/

enum button_action {
	BUTTON_PRESS = 1,
};

struct button_msg {
	uint32_t button_pin;
	enum button_action button_action;
};

enum le_audio_evt_type {
	LE_AUDIO_EVT_CONFIG_RECEIVED = 1,
	LE_AUDIO_EVT_PRES_DELAY_SET,
	LE_AUDIO_EVT_STREAMING,
	LE_AUDIO_EVT_NOT_STREAMING,
	LE_AUDIO_EVT_SYNC_LOST,
	LE_AUDIO_EVT_NO_VALID_CFG,
	LE_AUDIO_EVT_COORD_SET_DISCOVERED,
};

struct le_audio_msg {
	enum le_audio_evt_type event;
	struct bt_conn *conn;
	struct bt_le_per_adv_sync *pa_sync;
	enum bt_audio_dir dir;
	uint8_t set_size;
	uint8_t const *sirk;
};

/**
 * tx_sync_ts_us	The timestamp from get_tx_sync.
 * curr_ts_us		The current time. This must be in the controller frame of reference.
 */
struct sdu_ref_msg {
	uint32_t tx_sync_ts_us;
	uint32_t curr_ts_us;
	bool adjust;
};

enum bt_mgmt_evt_type {
	BT_MGMT_EXT_ADV_WITH_PA_READY = 1,
	BT_MGMT_CONNECTED,
	BT_MGMT_SECURITY_CHANGED,
	BT_MGMT_PA_SYNCED,
	BT_MGMT_PA_SYNC_LOST,
	BT_MGMT_DISCONNECTED,
};

struct bt_mgmt_msg {
	enum bt_mgmt_evt_type event;
	struct bt_conn *conn;
	uint8_t index;
	struct bt_le_ext_adv *ext_adv;
	struct bt_le_per_adv_sync *pa_sync;
	uint32_t broadcast_id;
	uint8_t pa_sync_term_reason;
};

enum volume_evt_type {
	VOLUME_UP = 1,
	VOLUME_DOWN,
	VOLUME_SET,
	VOLUME_MUTE,
	VOLUME_UNMUTE,
};

struct volume_msg {
	enum volume_evt_type event;
	uint8_t volume;
};

enum content_control_evt_type {
	MEDIA_START = 1,
	MEDIA_STOP,
};

struct content_control_msg {
	enum content_control_evt_type event;
};

#endif /* _ZBUS_COMMON_H_ */
```
