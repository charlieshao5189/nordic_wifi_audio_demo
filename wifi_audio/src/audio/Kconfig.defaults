## wifi_audio/src/audio/Kconfig.defaults
```kconfig
#
# Copyright (c) 2024 Nordic Semiconductor
#
# SPDX-License-Identifier: LicenseRef-Nordic-5-Clause
#

# Audio sync timer
config NRFX_TIMER1
	default y

# Audio sync timer
config NRFX_DPPI
	default y
```

## wifi_audio/src/net/Kconfig
```kconfig
#
# Copyright (c) 2024 Nordic Semiconductor
#
# SPDX-License-Identifier: LicenseRef-Nordic-5-Clause
#

#----------------------------------------------------------------------------#
rsource "Kconfig.defaults"

#----------------------------------------------------------------------------#
menu "NETWORK Module"

choice NETWORK_CONNECT_METHOD
	prompt "Choose network connection methods"
	default CONNECT_WITH_WIFI

config CONNECT_WITH_WIFI
	bool "Connect devices with Wi-Fi network"

config CONNECT_WITH_DECTNR
	bool "Connect devices with DECT NR+ network"

endchoice # NETWORK_CONNECTION_METHOD

endmenu #"NETWORK Module"

#----------------------------------------------------------------------------#
rsource "socket/Kconfig.socket_util_module"

if (CONNECT_WITH_WIFI)
        rsource "wifi/Kconfig.wifi_module"
endif # CONNECT_WITH_WIFI

#----------------------------------------------------------------------------#
module = NETWORK_MODULE
module-str = NETWORK module
source "subsys/logging/Kconfig.template.log_config"
```

## wifi_audio/src/net/Kconfig.defaults
```kconfig
#
# Copyright (c) 2024 Nordic Semiconductor
#
# SPDX-License-Identifier: LicenseRef-Nordic-5-Clause
#

#----------------------------------------------------------------------------#

# Networking
config NETWORKING
        default y
config NET_NATIVE
 	default y
config NET_SOCKETS
 	default y
config NET_LOG
 	default y
config NET_IPV4
 	default y
config NET_TCP
 	default y
config NET_UDP
 	default y
config NET_DHCPV4
 	default y
config NET_PKT_RX_COUNT
 	default 8
config NET_PKT_TX_COUNT
 	default 8


# Networking Management API
# Enable the Network Management relevant configurations
config NET_MGMT
 	default y
config NET_MGMT_EVENT
 	default y
config NET_MGMT_EVENT_INFO
 	default y
config NET_MGMT_EVENT_STACK_SIZE
 	default 4096
config NET_CONNECTION_MANAGER
 	default y
config L2_WIFI_CONNECTIVITY
 	default y


# Below section is the primary contributor to SRAM and is currently
# tuned for performance, but this will be revisited in the future.
config NET_BUF_RX_COUNT
 	default 16
config NET_BUF_TX_COUNT
 	default 16
config NET_BUF_DATA_SIZE
 	default 1500
config NET_TC_TX_COUNT
 	default 1

config NET_IF_UNICAST_IPV4_ADDR_COUNT
 	default 1
config NET_MAX_CONTEXTS
 	default 5
config NET_CONTEXT_SYNC_RECV
 	default y
config NET_L2_ETHERNET
 	default y

config NET_CONFIG_SETTINGS
 	default y
config NET_CONFIG_INIT_TIMEOUT
 	default 0
config NET_SOCKETS_POLL_MAX
 	default 10

config NET_CONFIG_MY_IPV4_ADDR
 	default "192.168.1.1"
config NET_CONFIG_MY_IPV4_NETMASK
 	default "255.255.255.0"
config NET_CONFIG_MY_IPV4_GW
 	default "192.168.1.1"

# printing of scan results puts pressure on queues in new locking
# design in net_mgmt. So, use a higher timeout for a crowded
# environment.
config NET_MGMT_EVENT_QUEUE_TIMEOUT
 	default 5000

config NET_TX_STACK_SIZE
 	default 4096
config NET_RX_STACK_SIZE
 	default 4096
```

## wifi_audio/src/net/socket/Kconfig
```kconfig
#
# Copyright (c) 2024 Nordic Semiconductor
#
# SPDX-License-Identifier: LicenseRef-Nordic-5-Clause
#

#----------------------------------------------------------------------------#

menu "mDNS settings"
  config MDNS_QUERY_NAME
      string "mDNS query name"
      default "zephyr"
      help
        Set the mDNS query name

  config MDNS_QUERY_ATTEMPTS
      int "mDNS query attempts"
      default 5
      help
        Set the number of mDNS query attempts

endmenu # mDNS settings
```

## wifi_audio/src/net/socket/Kconfig.defaults
```kconfig
#
# Copyright (c) 2024 Nordic Semiconductor
#
# SPDX-License-Identifier: LicenseRef-Nordic-5-Clause
#

#----------------------------------------------------------------------------#
config MDNS_QUERY_NAME
		string "mDNS query name"
		default "zephyr"
		help
			Set the mDNS query name
```

## wifi_audio/src/net/socket/Kconfig.socket_util_module
```kconfig
#
# Copyright (c) 2024 Nordic Semiconductor
#
# SPDX-License-Identifier: LicenseRef-Nordic-5-Clause
#

#----------------------------------------------------------------------------#
rsource "Kconfig.defaults"
rsource "Kconfig"

#----------------------------------------------------------------------------#
menu "Soket Utility Module"

config SOCKET_STACK_SIZE
	int "Stack size for encoder thread"
	default 8192

config SOCKET_UTIL_THREAD_PRIO
	int "Thread priority for socket thread"
	default 3

config SOCKET_TARGET_ADDR
	string "Target socket address socket to connect with"
        default ""

choice SOCKET_TYPE
	prompt "Choose socket type used for data transmission"
	default SOCKET_TYPE_UDP

config SOCKET_TYPE_UDP
	bool "Use UDP Socket for data tramsission"

config SOCKET_TYPE_TCP
	bool "Use TCP Socket for data transmission"

endchoice # AUDIO_STREAM_ROL

choice SOCKET_ROLE
	prompt "Set socket role: server to listen for incoming connections or client to connect to a server"
	default SOCKET_ROLE_SERVER

config SOCKET_ROLE_SERVER
	bool "Device works as socket server, listen for connection requests from client."

config SOCKET_ROLE_CLIENT
	bool "Device works as socket client, connect to a socket server."

endchoice # AUDIO_STREAM_ROL

endmenu # "Audio Stream Transceiver"

#----------------------------------------------------------------------------#
module = SOCKET_UTIL_MODULE
module-str = socket utility module
source "subsys/logging/Kconfig.template.log_config"
```

## wifi_audio/src/net/wifi/Kconfig.defaults
```kconfig
#
# Copyright (c) 2024 Nordic Semiconductor
#
# SPDX-License-Identifier: LicenseRef-Nordic-5-Clause
#

#----------------------------------------------------------------------------#
# # Wi-Fi
config WIFI
 	default y
config WIFI_NRF700X
 	default y

# # WPA supplicant
config WPA_SUPP
 	default y

# Station Mode
# Configure the Wi-Fi credentials
config WIFI_CREDENTIALS
 	default y
config WIFI_CREDENTIALS_STATIC
 	default n
# config WIFI_CREDENTIALS_BACKEND_SETTINGS
#  	default y
config FLASH
 	default y
config FLASH_PAGE_LAYOUT
 	default y
config FLASH_MAP
 	default y
config NVS
 	default y
# config SETTINGS_NVS
#  	default y
config SETTINGS
 	default y
# Enable support for shell commands
config SHELL
 	default y
config SHELL_STACK_SIZE
 	default 8192
config WIFI_CREDENTIALS_SHELL
 	default y
```
